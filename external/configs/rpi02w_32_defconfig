## external/configs/rpi02w_32_defconfig
```kconfig
# Architecture Setup (32-bit ARMv7 Hard-Float)
BR2_arm=y
BR2_cortex_a53=y
BR2_ARM_EABIHF=y
BR2_ARM_FPU_NEON_VFPV4=y

# Kernel Setup
BR2_LINUX_KERNEL_DEFCONFIG="bcm2709"
BR2_LINUX_KERNEL_INTREE_DTS_NAME="broadcom/bcm2710-rpi-zero-2-w"
BR2_LINUX_KERNEL_ZIMAGE=y

# Raspberry Pi Firmware Setup
BR2_PACKAGE_RPI_FIRMWARE_BOOTCODE_BIN=y
BR2_PACKAGE_RPI_FIRMWARE_VARIANT_PI=y
BR2_PACKAGE_RPI_FIRMWARE_VARIANT_PI_CD=y

# Bootloader Setup (32-bit U-Boot)
BR2_TARGET_UBOOT_BOARD_DEFCONFIG="rpi_3_32b"
```
